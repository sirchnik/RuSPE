/*
 * SPDX-FileCopyrightText: Infineon Technologies AG
 *
 * SPDX-License-Identifier: MIT
 */

SECTIONS {

    _rom_start = ORIGIN(ROM);
    _rom_limit = ORIGIN(ROM) + LENGTH(ROM);
    _ram_start = ORIGIN(RAM);
    _ram_limit = ORIGIN(RAM) + LENGTH(RAM);

    /* Sections located in ROM at runtime.
     */

    /* Text section -- the application's code. */
    .text ALIGN(4) : {
		KEEP(*(.vectors .vectors.*))
        *(.text .text.*)
    } > ROM

    /* Read-only data section. Contains strings and other global constants. */
    .rodata ALIGN(4) : {
        *(.rodata .rodata.*)

        /* Generated by GCC in libraries for variables that still have relocations but are constant
         * at runtime. See https://www.airs.com/blog/archives/189 for background.
         */
        *(.data.rel.ro.*)
    } > ROM

    /* Sections located in RAM at runtime.
     */

    /* Read-write data section. This is deployed as part of ROM but is copied
     * into RAM at runtime.
     */
    .data ALIGN(4) : {
        . = ALIGN(4);
        _sdata = .;
        /* .sdata is the RISC-V small data section */
        *(.sdata .sdata.* .data .data.*)
        /* Pad to word alignment so the relocation loop can use word-sized
         * copies.
         */
        . = ALIGN(4);
        _edata = .;
    } > RAM AT > ROM

    /* BSS section. These are zero-initialized static variables. This section is
     * not copied from ROM into RAM but rather directly initialized, and is
     * mainly put in this linker script so that we get an error if it overflows
     * the RAM region.
     */
    .bss ALIGN(4) (NOLOAD) : {
        . = ALIGN(4);
        _szero = .;
        /* .sbss is the RISC-V small data section */
        *(.sbss .sbss.* .bss .bss.*)
        *(COMMON)
        . = ALIGN(4);
        _ezero = .;
    } > RAM AT > ROM


    _stack_limit = .;
    _stack_top = ORIGIN(RAM) + LENGTH(RAM);

    _etext = LOADADDR(.data);  /* Start of .data in ROM */

    /* Sections we do not need. */
    /DISCARD/ :
    {
      *(.ARM.exidx .eh_frame)
    }
}
