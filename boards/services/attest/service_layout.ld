SECTIONS {

    /* Sections located in ROM at runtime.
     */

    /* Text section -- the application's code. */
    .text ALIGN(4) : {
		KEEP(*(.vectors .vectors.*))
        *(.text.*)
    } > ROM

    /* Read-only data section. Contains strings and other global constants. */
    .rodata ALIGN(4) : {
        *(.rodata.*)

        /* Generated by GCC in libraries for variables that still have relocations but are constant
         * at runtime. See https://www.airs.com/blog/archives/189 for background.
         */
        *(.data.rel.ro.*)
    } > ROM

    /* Sections located in RAM at runtime.
     */

    /* Read-write data section. This is deployed as part of ROM but is copied
     * into RAM at runtime.
     */
    .data ALIGN(4) : {
        _sdata = .;
        /* .sdata is the RISC-V small data section */
        *(.sdata .data*)
        /* Pad to word alignment so the relocation loop can use word-sized
         * copies.
         */
        . = ALIGN(4);
        _edata = .;
    } > RAM AT > ROM

    /* BSS section. These are zero-initialized static variables. This section is
     * not copied from ROM into RAM but rather directly initialized, and is
     * mainly put in this linker script so that we get an error if it overflows
     * the RAM region.
     */
    .bss ALIGN(4) (NOLOAD) : {
        _szero = .;
        /* .sbss is the RISC-V small data section */
        *(.sbss .bss.*)
        _ezero = .;
    } > RAM AT > ROM

    . = ORIGIN(RAM) + LENGTH(RAM);
    _stack_top = .;
    ASSERT(_ezero <= _stack_top - 32, "attest RAM leaves no room for PSP frame")

    _etext = LOADADDR(.data);  /* Start of .data in ROM */

    /* Sections we do not need. */
    /DISCARD/ :
    {
      *(.ARM.exidx .eh_frame)
    }
}
